## arch/arm/mach-nxp2120/Kconfig
```kconfig
config ARCH_NXP2120
	bool "Nexell NXP2120"
	select MACH_NXP2120
	select CPU_NXP2120
	select CPU_V6
	select GPIOLIB
	select ARCH_REQUIRE_GPIOLIB	
	select PINCTRL	
	select USE_OF	
#	select IRQ_DOMAIN_HIERARCHY	
#	select GENERIC_IRQ_CHIP
#	select ARM_AMBA
#	select ARM_GIC
#	select ARM_VIC
#	select HAVE_SMP
#	select MIGHT_HAVE_CACHE_L2X0
	select ARCH_HAS_CPUFREQ
	select GENERIC_TIME
	select GENERIC_CLOCKEVENTS
	select GENERIC_GPIO
	select ARCH_REQUIRE_GPIOLIB
	select ZONE_DMA
	select HAVE_MACH_CLKDEV
#	select NEED_MACH_MEMORY_H
#	select NEED_MACH_IO_H
	select ARM_PATCH_PHYS_VIRT
	help
		Support for nexell nxp2120(ARM1176) platform

config MACH_NXP2120
	bool
	depends on ARCH_NXP2120
#	default n

config CPU_NXP2120
	bool "Nexell's P2120 SOC CPU"
	     depends on ARCH_NXP2120
#        select CPU_V6
#        select GENERIC_TIME
#	select ARCH_WANT_OPTIONAL_GPIOLIB
#	depends on ARCH_NXP2120
#	default n
#    help
#    	Enable NXP2120 CPU support
```

## drivers/media/platform/nxp2120/Kconfig
```kconfig
#
# Copyright 2010 Nexell.
#
# Configuration options for the Nexell VIP SoC

menuconfig VIDEO_NXP2120
	bool "V4L2 driver for NXP2120"
	depends on CPU_NXP2120
	select VIDEOBUF2_DMA_CONTIG
	default n
	---help---
		This is representative nxp2120 v4l2 device.

if VIDEO_NXP2120

config V4L2_DRIVER_NXP2120
	tristate "V4L2 Drivers for NXP2120"
	depends on VIDEO_V4L2 && I2C && ARCH_NXP2120
	---help---
		Support for V4L2 driver for NXP2120 VIP port.

config V4L2_DRIVER_NXP2120_MODULE0
	bool "V4L2 Module 0"
	depends on V4L2_DRIVER_NXP2120
	default y

config V4L2_DRIVER_NXP2120_MODULE1
	bool "V4L2 Module 1"
	depends on V4L2_DRIVER_NXP2120
	default n

endif
#source "drivers/media/video/nexell/Kconfig-camera"
```
